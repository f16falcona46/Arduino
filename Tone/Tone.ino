#define F_CPU 8000000UL
#include <util/delay.h>
#include <avr/sleep.h>
#include <avr/io.h>
#include <avr/pgmspace.h>

//const unsigned char sine_table[] PROGMEM = {128,131,134,137,140,143,146,149,152,156,159,162,165,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121,124};
//const unsigned char short_wave[] PROGMEM = //{128,147,167,185,202,217,231,241,249,254,255,254,250,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97,78};
const unsigned char short_wave2[] PROGMEM = {0,32,64,96,128,160,192,224};

void delayms(int ms) {
	for (int i = 0; i < ms; ++i) {
		_delay_ms(0.1);
	}
}

int main() {
	(ADCSRA &= ~(1<<ADEN)); //disable adc
	PLLCSR |= (1<<PLLE); //enable PLL
	PLLCSR |= (1<<PCKE);
	TCCR1 = 0<<PWM1A | 0<<COM1A0 | 1<<CS10;
	GTCCR = 1<<PWM1B | 1<<COM1B1;
	DDRB |= (1<<PB4);
	/*
	for (int i = 10; i > 0; --i) {
		int max = 1000/i;
		for (int j = 0; j<max; ++j) {
			PORTB ^= (1<<PB4);
			delayms(i);
		}
	}
	*/
	while (1) {
		for (int i = 0; i < 65535; ++i) {
			OCR1B=(i<<4)%256;//short_wave2[i%8];
			_delay_us(125);
		}
	}
	sleep_enable();
	sleep_cpu();
}